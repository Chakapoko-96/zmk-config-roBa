## config/west.yml
```yaml
manifest:
remotes:
- name: zmkfirmware
url-base: https://github.com/zmkfirmware
- name: kumamuk-git
url-base: https://github.com/kumamuk-git
- name: zephyrproject-rtos
url-base: https://github.com/zephyrproject-rtos
projects:
- name: zmk
remote: zmkfirmware
revision: v0.2.1
import: app/west.yml
- name: zmk-pmw3610-driver
remote: kumamuk-git
revision: main
- name: zephyr
remote: zephyrproject-rtos
revision: v0.2.1
self:
path: config
    
```
